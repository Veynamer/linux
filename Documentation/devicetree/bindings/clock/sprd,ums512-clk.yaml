## drivers/input/touchscreen/TD4160/Kconfig
```kconfig
config TOUCHSCREEN_OMNIVISION_TCM
	tristate "Omnivision TCM touchscreen (TD4160, SPI)"
	depends on SPI
	depends on OF
	default n
	help
	  Say Y here if you have an Omnivision TCM touchscreen
	  controller (TD4160) connected over SPI.

	  If unsure, say N.
```

## drivers/net/wireless/sprdwcn/Kconfig
```kconfig
# SPDX-License-Identifier: GPL-2.0
#
# Unisoc Marlin3-Lite (SC2355) external WCN combo (Wi-Fi/BT/FM/GNSS) over SDIO.
#
menu "Unisoc WCN (Marlin3) device drivers"

config UNISOC_WCN_BSP
	tristate "Unisoc external WCN (Marlin3/SC2355) platform support"
	depends on MMC && OF
	help
	  Platform/transport core for the Unisoc external WCN combo chip
	  (Marlin3-Lite / SC2355) attached over SDIO: chip power sequencing,
	  firmware download, sdiohal transport and channel mux. Wi-Fi, BT,
	  FM and GNSS function drivers sit on top of this. Say M/Y to enable.

config SC23XX
	bool "SC23XX-family chip support"
	depends on UNISOC_WCN_BSP
	default UNISOC_WCN_BSP

config SC2355
	bool "SC2355 (Marlin3-Lite) chip support"
	depends on SC23XX
	default SC23XX

config SDIOHAL
	bool "SDIO HAL transport"
	depends on SC23XX
	default SC23XX

config WCN_SLP
	bool "WCN sleep/power management"
	depends on SDIOHAL
	default SDIOHAL

endmenu
```

## drivers/net/wireless/unisoc/Kconfig
```kconfig
# SPDX-License-Identifier: GPL-2.0-only
config WLAN_VENDOR_UNISOC
	bool "Unisoc devices"
	default y
	help
	  If you have a wireless card belonging to this class, say Y.

	  Note that the answer to this question doesn't directly affect the
	  kernel: saying N will just cause the configurator to skip all the
	  questions about these cards. If you say Y, you will be asked for
	  your specific card in the following questions.

if WLAN_VENDOR_UNISOC

config SC23XX_CORE
	tristate
	select CRC16

config SC23XX_SIPC
	tristate "Unisoc UMW26xx/SC23xx series integrated WiFi support"
	depends on CFG80211
	depends on RPMSG
	select SC23XX_CORE
	help
	  This driver implements support for WiFi on Unisoc SoCs with an
	  integrated wireless controller combined with an SC23xx-series
	  chip.

config SC23XX_SDIO
	tristate "Unisoc SC2355 external SDIO WiFi support"
	depends on CFG80211
	depends on UNISOC_WCN_BSP
	select SC23XX_CORE
	help
	  This driver implements support for WiFi on an external Unisoc
	  SC2355 (Marlin3-Lite) WiFi/BT combo chip attached over SDIO,
	  using the sprdwcn BSP bus (sdiohal) for transport and firmware
	  download.

endif
```

## drivers/soc/sprd/Kconfig
```kconfig
# SPDX-License-Identifier: GPL-2.0-only

menu "Spreadtrum and Unisoc SoC drivers"

config SPRD_SOCINFO
	tristate "Unisoc SoC information driver"
	depends on ARCH_SPRD || COMPILE_TEST
	depends on SOC_BUS
	select REGMAP
	help
	  Say y here to expose Unisoc SoC identification information through
	  the SoC bus. The driver reads the chip, platform, implementation,
	  manufacturer and version IDs from the AON APB registers.

config SPRD_AGDSP
	tristate "Audio DSP support"
	depends on ARCH_SPRD || COMPILE_TEST
	depends on MAILBOX
	help
	  Say y here to enable support for communication with the audio
	  DSP found in Spreadtrum/Unisoc SoCs.

endmenu
```
