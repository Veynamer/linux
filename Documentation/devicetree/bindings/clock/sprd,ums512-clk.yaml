## arch/arm64/configs/ums512_defconfig
```kconfig
CONFIG_LOCALVERSION="-sprd"
# CONFIG_LOCALVERSION_AUTO is not set

# Infinix HOT 12 Play NFC (X6816D)
CONFIG_TOUCHSCREEN_OMNIVISION_TCM=y
CONFIG_DRM_PANEL_OMNIVISION_TD4160TM_720_1640=y
CONFIG_CHARGER_AW32207=m
CONFIG_CHARGER_SC27XX_BC1P2=y
CONFIG_FUEL_GAUGE_SC27XX=m
CONFIG_REGULATOR_SC2730=y
CONFIG_NVMEM_SC27XX_EFUSE=y
CONFIG_RTC_DRV_SC27XX=y
CONFIG_LEDS_SC27XX_BLTC=y
CONFIG_SC27XX_ADC=m
CONFIG_INPUT_SC27XX_VIBRA=m
CONFIG_TYPEC_SC27XX_PD=y
CONFIG_POWER_RESET_SC27XX=y
CONFIG_MFD_SC27XX_PMIC=y
CONFIG_SC27XX_WATCHDOG=y
CONFIG_NFC=m
CONFIG_NFC_NCI=m
CONFIG_NFC_NXP_NCI=m
CONFIG_NFC_NXP_NCI_I2C=m
CONFIG_GNSS=m
CONFIG_GNSS_SPRD=m

# SoC
CONFIG_NR_CPUS=8
CONFIG_ARCH_SPRD=y
CONFIG_ARM64_ERRATUM_2441007=y
CONFIG_ARM64_ERRATUM_1286807=y
CONFIG_ARM64_VA_BITS_39=y
CONFIG_NUMA=y
CONFIG_COMPAT=y
CONFIG_RANDOMIZE_BASE=y
CONFIG_PM_AUTOSLEEP=y
CONFIG_PM_WAKELOCKS=y
CONFIG_WQ_POWER_EFFICIENT_DEFAULT=y
CONFIG_ENERGY_MODEL=y
CONFIG_CPU_IDLE=y
CONFIG_ARM_PSCI_CPUIDLE=y
CONFIG_CPU_FREQ=y
CONFIG_CPU_FREQ_STAT=y
CONFIG_CPU_FREQ_GOV_POWERSAVE=m
CONFIG_CPU_FREQ_GOV_USERSPACE=y
CONFIG_CPU_FREQ_GOV_ONDEMAND=y
CONFIG_CPU_FREQ_GOV_CONSERVATIVE=m
CONFIG_CPUFREQ_DT=y
CONFIG_KPROBES=y
CONFIG_MODULES=y
CONFIG_MODULE_UNLOAD=y
CONFIG_MODULE_COMPRESS=y
CONFIG_MODULE_COMPRESS_ZSTD=y
CONFIG_MODULE_DECOMPRESS=y
CONFIG_BLK_DEV_THROTTLING=y
CONFIG_BINFMT_MISC=m
# CONFIG_COMPAT_BRK is not set
CONFIG_KSM=y
CONFIG_TRANSPARENT_HUGEPAGE=y
CONFIG_CMA=y
CONFIG_CMA_SIZE_MBYTES=32
CONFIG_DMA_CMA=y

# Platform
CONFIG_SYSVIPC=y
CONFIG_POSIX_MQUEUE=y
CONFIG_AUDIT=y
CONFIG_NO_HZ_IDLE=y
CONFIG_HIGH_RES_TIMERS=y
CONFIG_BPF_SYSCALL=y
CONFIG_BPF_JIT=y
CONFIG_BPF_LSM=y
CONFIG_PREEMPT=y
CONFIG_IRQ_TIME_ACCOUNTING=y
CONFIG_BSD_PROCESS_ACCT=y
CONFIG_BSD_PROCESS_ACCT_V3=y
CONFIG_TASKSTATS=y
CONFIG_TASK_XACCT=y
CONFIG_TASK_IO_ACCOUNTING=y
CONFIG_PSI=y
CONFIG_IKCONFIG=y
CONFIG_IKCONFIG_PROC=y
CONFIG_UCLAMP_TASK=y
CONFIG_NUMA_BALANCING=y
CONFIG_MEMCG=y
CONFIG_BLK_CGROUP=y
CONFIG_CFS_BANDWIDTH=y
CONFIG_UCLAMP_TASK_GROUP=y
CONFIG_CGROUP_PIDS=y
CONFIG_CGROUP_FREEZER=y
CONFIG_CPUSETS=y
CONFIG_CGROUP_DEVICE=y
CONFIG_CGROUP_CPUACCT=y
CONFIG_CGROUP_PERF=y
CONFIG_CGROUP_BPF=y
CONFIG_NAMESPACES=y
CONFIG_USER_NS=y
CONFIG_CHECKPOINT_RESTORE=y
CONFIG_SCHED_AUTOGROUP=y
CONFIG_BLK_DEV_INITRD=y
CONFIG_SYSFS_SYSCALL=y
CONFIG_EXPERT=y
CONFIG_PROFILING=y
CONFIG_KEXEC=y
CONFIG_KEXEC_FILE=y
CONFIG_DEVTMPFS=y
CONFIG_DEVTMPFS_MOUNT=y
CONFIG_FW_LOADER_COMPRESS=y
CONFIG_FW_LOADER_COMPRESS_ZSTD=y
CONFIG_BLK_DEV_LOOP=y

# Sound
CONFIG_SOUND=m
CONFIG_SND=m
CONFIG_SND_DYNAMIC_MINORS=y
CONFIG_SND_SUPPORT_OLD_API=y
CONFIG_SND_USB_AUDIO=m
CONFIG_SND_USB_AUDIO_MIDI_V2=y
CONFIG_SND_SOC=m
CONFIG_SND_SOC_SPRD=m
CONFIG_SND_SOC_SPRD_UMS9230=m
CONFIG_SND_SOC_SC2730=m
CONFIG_SND_SOC_BT_SCO=m
CONFIG_SND_SOC_DMIC=m
CONFIG_SND_SOC_SIMPLE_AMPLIFIER=m
CONFIG_SND_SOC_SIMPLE_MUX=m
CONFIG_SND_SOC_SPDIF=m
CONFIG_SND_SOC_UMS9230_DIGITAL=m
CONFIG_SND_SIMPLE_CARD=m
CONFIG_SND_AUDIO_GRAPH_CARD=m
CONFIG_SND_AUDIO_GRAPH_CARD2=m

# Display
CONFIG_DRM=y
CONFIG_DRM_PANIC=y
CONFIG_DRM_PANIC_BACKGROUND_COLOR=0x001c3f
CONFIG_DRM_PANIC_SCREEN="kmsg"
# CONFIG_DRM_DEBUG_MODESET_LOCK is not set
CONFIG_DRM_PANEL_DSI_CM=y
CONFIG_DRM_PANFROST=m
CONFIG_DRM_SPRD=y
CONFIG_DRM_SIMPLEDRM=y
CONFIG_FB=y
CONFIG_BACKLIGHT_CLASS_DEVICE=y
CONFIG_BACKLIGHT_PWM=y

# Camera
CONFIG_MEDIA_SUPPORT=m
CONFIG_MEDIA_SUPPORT_FILTER=y
CONFIG_MEDIA_CAMERA_SUPPORT=y
CONFIG_MEDIA_PLATFORM_SUPPORT=y
CONFIG_MEDIA_USB_SUPPORT=y
CONFIG_USB_VIDEO_CLASS=m
CONFIG_V4L_PLATFORM_DRIVERS=y
CONFIG_V4L_MEM2MEM_DRIVERS=y
CONFIG_VIDEO_SPRD_CAMSYS=m
CONFIG_VIDEO_SPRD_ISP=m

# Input
CONFIG_INPUT_FF_MEMLESS=y
CONFIG_INPUT_MATRIXKMAP=y
CONFIG_INPUT_EVDEV=y
CONFIG_KEYBOARD_GPIO=y
CONFIG_INPUT_TOUCHSCREEN=y
CONFIG_INPUT_MISC=y
CONFIG_INPUT_UINPUT=y

# Notification LED
CONFIG_LEDS_CLASS=y
CONFIG_LEDS_CLASS_FLASH=y
CONFIG_LEDS_CLASS_MULTICOLOR=m
CONFIG_LEDS_GPIO=y
CONFIG_LEDS_PWM=y
CONFIG_LEDS_SYSCON=y
CONFIG_LEDS_TRIGGER_PATTERN=m
CONFIG_LEDS_TRIGGER_ONESHOT=y
CONFIG_LEDS_TRIGGER_BACKLIGHT=y
CONFIG_LEDS_TRIGGER_ACTIVITY=y

# Power management
CONFIG_POWER_SEQUENCING=m
CONFIG_REGULATOR=y
CONFIG_REGULATOR_FIXED_VOLTAGE=y
CONFIG_REGULATOR_GPIO=y
CONFIG_REGULATOR_PWM=y
CONFIG_THERMAL=y
CONFIG_THERMAL_GOV_POWER_ALLOCATOR=y
CONFIG_CPU_THERMAL=y
CONFIG_DEVFREQ_THERMAL=y
CONFIG_GENERIC_ADC_THERMAL=m
CONFIG_SPRD_THERMAL=m
CONFIG_WATCHDOG=y
CONFIG_SPRD_WATCHDOG=y
CONFIG_NVMEM_REBOOT_MODE=m

# MGLRU
CONFIG_LRU_GEN=y
CONFIG_LRU_GEN_ENABLED=y

# Misc useful things
CONFIG_SCSI_SCAN_ASYNC=y
CONFIG_DMABUF_HEAPS=y
CONFIG_DMABUF_HEAPS_CMA=y
CONFIG_DMABUF_HEAPS_SYSTEM=y
CONFIG_UDMABUF=y
CONFIG_HZ_1000=y
CONFIG_QFMT_V2=y

# Android userdata
CONFIG_EXT4_FS=y
CONFIG_EXT4_FS_POSIX_ACL=y
CONFIG_EXT4_FS_SECURITY=y
CONFIG_F2FS_FS=m
CONFIG_F2FS_FS_POSIX_ACL=y
CONFIG_QUOTA=y

# Filesystems
CONFIG_VFAT_FS=y
CONFIG_EXFAT_FS=m
CONFIG_TMPFS=y
CONFIG_TMPFS_POSIX_ACL=y
CONFIG_TMPFS_XATTR=y
CONFIG_CONFIGFS_FS=y
CONFIG_OVERLAY_FS=m
CONFIG_SQUASHFS=m
CONFIG_SQUASHFS_XATTR=y
CONFIG_SQUASHFS_LZ4=y
CONFIG_SQUASHFS_XZ=y
CONFIG_EROFS_FS=m
CONFIG_EROFS_FS_ZIP_DEFLATE=y
CONFIG_EROFS_FS_ZIP_ZSTD=y
CONFIG_NLS_CODEPAGE_437=y
CONFIG_NLS_ASCII=y
CONFIG_NLS_ISO8859_1=y

# Persistent store
CONFIG_PSTORE=y
CONFIG_PSTORE_CONSOLE=y
CONFIG_PSTORE_PMSG=y
CONFIG_PSTORE_RAM=y
CONFIG_PSTORE_COMPRESS=y

# Bluetooth && WLAN
CONFIG_BT=m
CONFIG_BT_RFCOMM=m
CONFIG_BT_RFCOMM_TTY=y
CONFIG_BT_BNEP=m
CONFIG_BT_BNEP_MC_FILTER=y
CONFIG_BT_BNEP_PROTO_FILTER=y
CONFIG_BT_HIDP=m
CONFIG_BT_MSFTEXT=y
CONFIG_BT_AOSPEXT=y
# CONFIG_BT_DEBUGFS is not set
CONFIG_BT_HCIUART=m
CONFIG_BT_SPRDSIPC=m
CONFIG_BT_SPRDSDIO=m
CONFIG_WIRELESS=y
CONFIG_WLAN=y
CONFIG_WLAN_VENDOR_UNISOC=y
CONFIG_CFG80211=m
CONFIG_MAC80211=m
CONFIG_MAC80211_LEDS=y
CONFIG_RFKILL=m
CONFIG_RFKILL_INPUT=y
CONFIG_UNISOC_WCN_BSP=m
CONFIG_SC23XX=y
CONFIG_SC23XX_SIPC=m
CONFIG_SC23XX_SDIO=m

# USB
CONFIG_USB=y
CONFIG_USB_OTG=y
CONFIG_USB_ANNOUNCE_NEW_DEVICES=y
CONFIG_USB_MUSB_HDRC=y
CONFIG_USB_MUSB_SPRD=y
CONFIG_USB_STORAGE=m
CONFIG_USB_UAS=m
CONFIG_USB_GADGET=y
CONFIG_U_SERIAL_CONSOLE=y
CONFIG_USB_CONFIGFS=y
CONFIG_USB_CONFIGFS_SERIAL=y
CONFIG_USB_CONFIGFS_ACM=y
CONFIG_USB_CONFIGFS_NCM=y
CONFIG_USB_CONFIGFS_ECM=y
CONFIG_USB_CONFIGFS_ECM_SUBSET=y
CONFIG_USB_CONFIGFS_RNDIS=y
CONFIG_USB_CONFIGFS_MASS_STORAGE=y
CONFIG_USB_CONFIGFS_F_FS=y
CONFIG_USB_CONFIGFS_F_HID=y
CONFIG_TYPEC=y
CONFIG_TYPEC_TCPM=y
CONFIG_PHY_SPRD_USB2=y
CONFIG_USB_USBNET=y
CONFIG_USB_NET_CDC_NCM=y

# NCM
CONFIG_USB_NET_RNDIS_HOST=m
CONFIG_USB_HIDDEV=y
CONFIG_HID_BATTERY_STRENGTH=y
CONFIG_HIDRAW=y
CONFIG_UHID=m
CONFIG_HID_GENERIC=m
CONFIG_HID_PID=y

# Storage
CONFIG_SCSI=y
CONFIG_BLK_DEV_SD=y
CONFIG_MD=y
CONFIG_MMC=y
CONFIG_MMC_BLOCK_MINORS=32
CONFIG_MMC_SDHCI=y
CONFIG_MMC_SDHCI_PLTFM=y
CONFIG_MMC_SDHCI_SPRD=y
CONFIG_MMC_CQHCI=y
CONFIG_SCSI_UFSHCD=y
CONFIG_SCSI_UFS_BSG=y
CONFIG_SCSI_UFSHCD_PLATFORM=y
CONFIG_SCSI_UFS_SPRD=y

# Remoteproc
CONFIG_REMOTEPROC=y
CONFIG_SPRD_MODEM_REMOTEPROC=m
CONFIG_SPRD_PMSYS_REMOTEPROC=m
CONFIG_SPRD_WCN_REMOTEPROC=m
CONFIG_RPMSG_CHAR=m
CONFIG_RPMSG_CTRL=m
CONFIG_RPMSG_SPRD_SIPC=m
CONFIG_SPRD_AGDSP=y
CONFIG_SPRD_PM_DOMAINS=y

# Storage / DMA / IOMMU
CONFIG_DMADEVICES=y
CONFIG_SPRD_DMA=y
CONFIG_MAILBOX=y
CONFIG_HWSPINLOCK=y
CONFIG_HWSPINLOCK_SPRD=y
CONFIG_SPRD_MBOX=y
CONFIG_IOMMU_IO_PGTABLE_ARMV7S=y
CONFIG_ARM_SMMU=y
CONFIG_ARM_SMMU_V3=y
CONFIG_SPRD_IOMMU=y

# Clocks / pinctrl / GPIO
CONFIG_COMMON_CLK=y
CONFIG_COMMON_CLK_PWM=y
CONFIG_SPRD_UMS512_CLK=y
CONFIG_PINCTRL=y
CONFIG_PINCTRL_SPRD_UMS512=y
CONFIG_GPIOLIB=y
CONFIG_GPIOLIB_IRQCHIP=y
CONFIG_GPIO_SYSFS=y
# CONFIG_GPIO_SYSFS_LEGACY is not set
CONFIG_GPIO_CDEV_V1=y
CONFIG_GPIO_EIC_SPRD=y
CONFIG_GPIO_SPRD=y
CONFIG_GPIO_SYSCON=y
CONFIG_GPIO_PMIC_EIC_SPRD=y

# I2C / SPI / UART
CONFIG_I2C_CHARDEV=y
CONFIG_I2C_SPRD=y
CONFIG_I2C_SPRD_HW_V2=y
CONFIG_SPI=y
CONFIG_SPI_SPRD=y
CONFIG_SPI_SPRD_ADI=y
CONFIG_SPI_SPIDEV=m
CONFIG_LEGACY_PTY_COUNT=16
CONFIG_SERIAL_SPRD=y
CONFIG_SERIAL_SPRD_CONSOLE=y
CONFIG_NULL_TTY=m
CONFIG_RPMSG_TTY=m
CONFIG_SERIAL_DEV_BUS=y

# RTC / PWM / reset
CONFIG_RTC_CLASS=y
CONFIG_PWM=y
CONFIG_PWM_SPRD=y
CONFIG_RESET_CONTROLLER=y
CONFIG_RESET_GPIO=y
CONFIG_POWER_RESET_SYSCON=y
CONFIG_SYSCON_REBOOT_MODE=y

# NVMEM
CONFIG_NVMEM_SPRD_EFUSE=m

# Sensors
CONFIG_IIO=y
CONFIG_IIO_BUFFER=y
CONFIG_IIO_KFIFO_BUF=m
CONFIG_IIO_TRIGGERED_BUFFER=m
CONFIG_IIO_SPRD_SHUB=m
CONFIG_IIO_SPRD_SHUB_ACCEL=m
CONFIG_IIO_SPRD_SHUB_GYRO=m
CONFIG_IIO_SPRD_SHUB_LIGHT=m
CONFIG_IIO_SPRD_SHUB_COMPASS=m
CONFIG_IIO_SPRD_SHUB_MAGN=m
CONFIG_IIO_SPRD_SHUB_PROXIMITY=m

# Networking
CONFIG_NET=y
CONFIG_UNIX=y
CONFIG_INET=y
CONFIG_IPV6=y
CONFIG_PACKET=y
CONFIG_INET_DIAG=y
CONFIG_INET_TCP_DIAG=y
CONFIG_SYN_COOKIES=y
CONFIG_NET_IP_TUNNEL=m
CONFIG_IPV6_SIT=m
CONFIG_NETDEVICES=y
CONFIG_IP_MULTICAST=y
CONFIG_IP_ADVANCED_ROUTER=y
CONFIG_IP_MULTIPLE_TABLES=y
CONFIG_IP_PNP=y
CONFIG_IP_PNP_DHCP=y
CONFIG_IPV6_MULTIPLE_TABLES=y
CONFIG_NETFILTER=y
CONFIG_BRIDGE_NETFILTER=m
CONFIG_NF_CONNTRACK=m
CONFIG_NF_TABLES=m
CONFIG_NF_TABLES_INET=y
CONFIG_NFT_CT=m
CONFIG_NFT_LOG=m
CONFIG_NFT_LIMIT=m
CONFIG_NFT_MASQ=m
CONFIG_NFT_NAT=m
CONFIG_NFT_REJECT=m
CONFIG_NF_TABLES_IPV4=y
CONFIG_NF_TABLES_IPV6=y
CONFIG_NFT_FIB=m
CONFIG_NFT_FIB_IPV4=m
CONFIG_NFT_FIB_IPV6=m
CONFIG_FIB_RULES=y
CONFIG_NETFILTER_XTABLES=m
CONFIG_NETFILTER_XTABLES_LEGACY=y
CONFIG_NETFILTER_XT_MARK=m
CONFIG_NETFILTER_XT_TARGET_TCPMSS=m
CONFIG_NETFILTER_XT_MATCH_TCPMSS=m
CONFIG_NETFILTER_XT_MATCH_IPVS=m
CONFIG_IP_NF_IPTABLES_LEGACY=m
CONFIG_IP_NF_IPTABLES=m
CONFIG_IP_NF_FILTER=m
CONFIG_IP_NF_TARGET_REJECT=m
CONFIG_IP_NF_NAT=m
CONFIG_IP_NF_TARGET_MASQUERADE=m
CONFIG_IP_NF_TARGET_REDIRECT=m
CONFIG_IP_NF_MANGLE=m
CONFIG_IP_NF_RAW=m
CONFIG_IP_NF_SECURITY=m
CONFIG_IP_NF_ARPTABLES=m
CONFIG_IP6_NF_IPTABLES_LEGACY=m
CONFIG_IP6_NF_IPTABLES=m
CONFIG_IP6_NF_FILTER=m
CONFIG_IP6_NF_TARGET_REJECT=m
CONFIG_IP6_NF_NAT=m
CONFIG_IP6_NF_TARGET_MASQUERADE=m
CONFIG_IP6_NF_MANGLE=m
CONFIG_IP6_NF_RAW=m
CONFIG_IP6_NF_SECURITY=m
CONFIG_IP_VS=m
CONFIG_IP_VS_NFCT=y
CONFIG_IP_VS_PROTO_TCP=y
CONFIG_IP_VS_PROTO_UDP=y
CONFIG_IP_VS_RR=m
CONFIG_BRIDGE=m
CONFIG_VLAN_8021Q=m
CONFIG_NET_SCHED=y
CONFIG_NET_SCH_HTB=y
CONFIG_NET_SCH_PRIO=y
CONFIG_NET_SCH_MULTIQ=y
CONFIG_NET_CLS_CGROUP=m
CONFIG_CGROUP_NET_PRIO=y
CONFIG_DNS_RESOLVER=y
CONFIG_DUMMY=m
CONFIG_WIREGUARD=m
CONFIG_MACVLAN=m
CONFIG_MACVTAP=m
CONFIG_IPVLAN=m
CONFIG_VXLAN=m
CONFIG_TUN=m
CONFIG_VETH=m
CONFIG_USB_NET_DRIVERS=y

# pmOS containers
CONFIG_DM_THIN_PROVISIONING=m

# pmOS ZRAM
CONFIG_ZSMALLOC=m
CONFIG_ZSMALLOC_STAT=y
CONFIG_ZRAM=m
CONFIG_ZRAM_BACKEND_ZSTD=y
CONFIG_ZRAM_DEF_COMP_ZSTD=y
CONFIG_ZRAM_MEMORY_TRACKING=y
CONFIG_ZRAM_MULTI_COMP=y
CONFIG_CRYPTO_LZ4=m
CONFIG_LZ4_COMPRESS=m
CONFIG_CRYPTO_ZSTD=m

# pmOS iwd
CONFIG_CRYPTO_USER_API_HASH=m
CONFIG_CRYPTO_USER_API_SKCIPHER=m
CONFIG_KEY_DH_OPERATIONS=y
CONFIG_CRYPTO_KPP=y
CONFIG_PKCS8_PRIVATE_KEY_PARSER=m

# pmOS wireguard
CONFIG_NF_CONNTRACK_MARK=y

# pmOS community

# Waydroid
CONFIG_ANDROID_BINDER_IPC=y
CONFIG_ANDROID_BINDERFS=y
CONFIG_ANDROID_BINDER_DEVICES="binder,hwbinder,vndbinder,puddlejumper,hwpuddlejumper,vndpuddlejumper"

# Firmware loading

#pmOS Related
CONFIG_VT=y
CONFIG_CRYPTO_XTS=y
CONFIG_BLK_DEV_DM=y
CONFIG_DM_CRYPT=y
CONFIG_DM_VERITY=m
CONFIG_CIFS=m
CONFIG_DRM_GUD=m

# LEDs
CONFIG_NEW_LEDS=y

# Game controllers, etc
CONFIG_HID_SONY=m
CONFIG_SONY_FF=y
CONFIG_HID_NINTENDO=m

# Security / crypto
CONFIG_SECURITY_DMESG_RESTRICT=y
CONFIG_SECURITY=y
CONFIG_SECURITY_SELINUX=y
CONFIG_SECURITY_SMACK=y
CONFIG_SECURITY_TOMOYO=y
CONFIG_SECURITY_YAMA=y
CONFIG_SECURITY_LOCKDOWN_LSM=y
CONFIG_SECURITY_LOCKDOWN_LSM_EARLY=y
CONFIG_DEFAULT_SECURITY_DAC=y
CONFIG_LSM="landlock,lockdown,yama,loadpin,safesetid,selinux,smack,tomoyo,ipe,bpf"
CONFIG_CRYPTO_USER=y
CONFIG_CRYPTO_NULL=y
CONFIG_CRYPTO_AES=y
CONFIG_CRYPTO_CBC=y
CONFIG_CRYPTO_CTS=y
CONFIG_CRYPTO_ESSIV=y
CONFIG_CRYPTO_BLAKE2B=y
CONFIG_CRYPTO_MD5=y
CONFIG_CRYPTO_SHA1=y
CONFIG_CRYPTO_SHA3=y
CONFIG_CRYPTO_XXHASH=y
CONFIG_CRYPTO_CRC32C=y
CONFIG_CRYPTO_DEFLATE=m
CONFIG_CRYPTO_LZO=y
CONFIG_CRYPTO_JITTERENTROPY=y
CONFIG_CRYPTO_GHASH_ARM64_CE=y
CONFIG_CRYPTO_AES_ARM64_BS=m
CONFIG_CRYPTO_AES_ARM64_CE_CCM=y

# Debugging / tracing
CONFIG_PRINTK_TIME=y
CONFIG_CONSOLE_LOGLEVEL_DEFAULT=8
CONFIG_DYNAMIC_DEBUG=y
CONFIG_DEBUG_INFO_DWARF5=y
CONFIG_MAGIC_SYSRQ=y
CONFIG_DEBUG_FS=y
CONFIG_STACKTRACE=y

# Disable all unrelated stuffs afaik
CONFIG_HIBERNATION=n
CONFIG_FW_LOADER_USER_HELPER=n
CONFIG_BLK_DEV_NVME=n
CONFIG_ATA=n
CONFIG_MTD=n
CONFIG_SRAM=n
CONFIG_MEGARAID_SAS=n
CONFIG_EEPROM_AT25=n
CONFIG_SCSI_MPT3SAS=n
CONFIG_DM_MIRROR=n
CONFIG_DM_ZERO=n
CONFIG_EXT2_FS=n
CONFIG_EXT3_FS=n
CONFIG_USB_DWC2=n
CONFIG_USB_CHIPIDEA=n
CONFIG_USB_ISP1760=n
CONFIG_USB_HSIC_USB3503=n
CONFIG_USB_NET_PLUSB=n
CONFIG_TYPEC_FUSB302=n
CONFIG_EXTCON_PTN5150=n
CONFIG_REALTEK_PHY=n
CONFIG_NET_VENDOR_NI=n
CONFIG_NET_9P=n
CONFIG_CAN=n
CONFIG_BNX2X=n
CONFIG_MACB=n
CONFIG_IGB=n
CONFIG_IGBVF=n
CONFIG_SMC91X=n
CONFIG_MLX4_EN=n
CONFIG_MLX5_CORE=n
CONFIG_STMMAC_ETH=n
CONFIG_ATL1C=n
CONFIG_BRCMFMAC=n
CONFIG_WL18XX=n
CONFIG_WLCORE=n
CONFIG_ATH10K_PCI=n
CONFIG_NET_SCH_CBS=n
CONFIG_NET_SCH_ETF=n
CONFIG_NET_SCH_TAPRIO=n
CONFIG_NET_SCH_MQPRIO=n
CONFIG_NET_CLS_BASIC=n
CONFIG_NET_CLS_FLOWER=n
CONFIG_NET_CLS_ACT=n
CONFIG_NET_ACT_GACT=n
CONFIG_NET_ACT_MIRRED=n
CONFIG_NET_ACT_GATE=n
CONFIG_MDIO_BUS_MUX_MMIOREG=n
CONFIG_MDIO_BUS_MUX_MULTIPLEXER=n
CONFIG_SND_SOC_ES7134=n
CONFIG_SND_SOC_ES7241=n
CONFIG_SND_SOC_TAS571X=n
CONFIG_GPIO_DWAPB=n
CONFIG_COMMON_CLK_XGENE=n
CONFIG_TCG_TPM=n
CONFIG_BATTERY_SBS=n
CONFIG_REGULATOR_VCTRL=n
CONFIG_SND_SOC_MAX98357A=n
CONFIG_SND_SOC_RL6231=n
CONFIG_THUNDER_NIC_BGX=n
CONFIG_THUNDER_NIC_RGX=n
CONFIG_MDIO_THUNDER=n
CONFIG_CAVIUM_ERRATUM_22375=n
CONFIG_CAVIUM_ERRATUM_23154=n
CONFIG_CAVIUM_ERRATUM_27456=n
CONFIG_CAVIUM_ERRATUM_30115=n
CONFIG_CAVIUM_TX2_ERRATUM_219=n
CONFIG_HW_RANDOM_CAVIUM=n
CONFIG_EEPROM_AT24=n
CONFIG_NET_DSA=n
CONFIG_AQUANTIA_PHY=n
CONFIG_MICROSEMI_PHY=n
CONFIG_VITESSE_PHY=n
CONFIG_I2C_MUX_PCA954x=n
CONFIG_SND_SOC_PCM3168A_I2C=n
CONFIG_SENSORS_LM90=n
CONFIG_SENSORS_INA2XX=n
CONFIG_RTC_DRV_DS3232=n
CONFIG_SPI_NXP_FLEXSPI=n
CONFIG_GPIO_MAX732X=n
CONFIG_SENSORS_ISL29018=n
CONFIG_MPL3115=n
CONFIG_MFD_ROHM_BD718XX=n
CONFIG_ARM_SBSA_WATCHDOG=n
CONFIG_ARM_SMC_WATCHDOG=n
CONFIG_REGULATOR_PCA9450=n
CONFIG_REGULATOR_PFUZE100=n
CONFIG_DRM_PANEL_RAYDIUM_RM67191=n
CONFIG_DRM_PANEL_SITRONIX_ST7703=n
CONFIG_PHY_MIXEL_MIPI_DPHY=n
CONFIG_DRM_NWL_MIPI_DSI=n
CONFIG_DRM_MXSFB=n
CONFIG_SND_SOC_FSL_SAI=n
CONFIG_SND_SOC_FSL_ASRC=n
CONFIG_SND_SOC_FSL_MICFIL=n
CONFIG_SND_SOC_FSL_AUDMIX=n
CONFIG_SND_SOC_FSL_SPDIF=n
CONFIG_SND_SOC_WM8904=n
CONFIG_RTC_DRV_RV8803=n
CONFIG_RTC_DRV_DS1307=n
CONFIG_RTC_DRV_PCF85363=n
CONFIG_RTC_DRV_PCF2127=n
CONFIG_PHY_FSL_IMX8MQ_USB=n
CONFIG_FUJITSU_ERRATUM_010001=n
CONFIG_PCI_PASID=n
CONFIG_UACCE=n
CONFIG_SPI_CADENCE_QUADSPI=n
CONFIG_DW_WATCHDOG=n
CONFIG_NOP_USB_XCEIV=n
CONFIG_SURFACE_PLATFORMS=n
CONFIG_GPIO_PCA953X=n
CONFIG_BACKLIGHT_LP855X=n
CONFIG_MFD_MAX77620=n
CONFIG_SENSORS_PWM_FAN=n
CONFIG_SENSORS_INA3221=n
CONFIG_REGULATOR_MAX8973=n
CONFIG_USB_CONN_GPIO=n
CONFIG_MICREL_PHY=n
CONFIG_MFD_BD9571MWV=n
CONFIG_DRM_PANEL_LVDS=n
CONFIG_DRM_RCAR_LVDS=n
CONFIG_COMMON_CLK_VC5=n
CONFIG_CRYPTO_DEV_CCREE=n
CONFIG_VIDEO_IMX219=n
CONFIG_VIDEO_OV5645=n
CONFIG_SND_SOC_AK4613=n
CONFIG_TYPEC_HD3SS3220=n
CONFIG_RTC_DRV_RX8581=n
CONFIG_COMMON_CLK_CS2000_CP=n
CONFIG_KEYBOARD_ADC=n
CONFIG_REGULATOR_FAN53555=n
CONFIG_TOUCHSCREEN_ATMEL_MXT=n
CONFIG_RTC_DRV_HYM8563=n
CONFIG_MFD_SEC_CORE=n
CONFIG_PL330_DMA=n
CONFIG_GPIO_MB86S7X=n
CONFIG_MMC_SDHCI_F_SDH30=n
CONFIG_MMC_SDHCI_CADENCE=n
CONFIG_SOCIONEXT_SYNQUACER_PREITS=n
CONFIG_NET_VENDOR_SOCIONEXT=n
CONFIG_ARCH_ACTIONS=n
CONFIG_ARCH_AGILEX=n
CONFIG_ARCH_N5X=n
CONFIG_ARCH_SUNXI=n
CONFIG_ARCH_ALPINE=n
CONFIG_ARCH_APPLE=n
CONFIG_ARCH_BCM2835=n
CONFIG_ARCH_BCM4908=n
CONFIG_ARCH_BCM_IPROC=n
CONFIG_ARCH_BERLIN=n
CONFIG_ARCH_BRCMSTB=n
CONFIG_ARCH_EXYNOS=n
CONFIG_ARCH_K3=n
CONFIG_ARCH_LAYERSCAPE=n
CONFIG_ARCH_LG1K=n
CONFIG_ARCH_HISI=n
CONFIG_ARCH_KEEMBAY=n
CONFIG_ARCH_MEDIATEK=n
CONFIG_ARCH_MESON=n
CONFIG_ARCH_MVEBU=n
CONFIG_ARCH_MXC=n
CONFIG_ARCH_RENESAS=n
CONFIG_ARCH_ROCKCHIP=n
CONFIG_ARCH_S32=n
CONFIG_ARCH_SEATTLE=n
CONFIG_ARCH_INTEL_SOCFPGA=n
CONFIG_ARCH_SYNQUACER=n
CONFIG_ARCH_TEGRA=n
CONFIG_ARCH_THUNDER=n
CONFIG_ARCH_THUNDER2=n
CONFIG_ARCH_UNIPHIER=n
CONFIG_ARCH_VEXPRESS=n
CONFIG_ARCH_VISCONTI=n
CONFIG_ARCH_XGENE=n
CONFIG_ARCH_ZX=n
CONFIG_ARCH_ZYNQMP=n
CONFIG_ARM_ALLWINNER_SUN50I_CPUFREQ_NVMEM=n
CONFIG_ARM_ARMADA_37XX_CPUFREQ=n
CONFIG_ARM_IMX_CPUFREQ_DT=n
CONFIG_ARM_RASPBERRYPI_CPUFREQ=n
CONFIG_ARM_TEGRA186_CPUFREQ=n
CONFIG_QORIQ_CPUFREQ=n
CONFIG_RASPBERRYPI_FIRMWARE=n
CONFIG_INTEL_STRATIX10_SERVICE=n
CONFIG_INTEL_STRATIX10_RSU=n
CONFIG_IMX_SCU=n
CONFIG_IMX_SCU_PD=n
CONFIG_CAN_RCAR=n
CONFIG_CAN_RCAR_CANFD=n
CONFIG_CAN_FLEXCAN=n
CONFIG_PCI_AARDVARK=n
CONFIG_PCI_TEGRA=n
CONFIG_PCIE_RCAR_HOST=n
CONFIG_PCIE_RCAR_EP=n
CONFIG_PCI_XGENE=n
CONFIG_PCIE_ALTERA=n
CONFIG_PCIE_ALTERA_MSI=n
CONFIG_PCI_HOST_THUNDER_PEM=n
CONFIG_PCI_HOST_THUNDER_ECAM=n
CONFIG_PCIE_ROCKCHIP_HOST=n
CONFIG_PCIE_BRCMSTB=n
CONFIG_PCI_IMX6=n
CONFIG_PCI_LAYERSCAPE=n
CONFIG_PCIE_LAYERSCAPE_GEN4=n
CONFIG_PCI_HISI=n
CONFIG_PCIE_ARMADA_8K=n
CONFIG_PCIE_KIRIN=n
CONFIG_PCIE_HISI_STB=n
CONFIG_PCIE_TEGRA194_HOST=n
CONFIG_HISILICON_LPC=n
CONFIG_FSL_MC_BUS=n
CONFIG_TEGRA_ACONNECT=n
CONFIG_MTD_CFI_INTELEXT=n
CONFIG_MTD_CFI_AMDSTD=n
CONFIG_MTD_CFI_STAA=n
CONFIG_MTD_SST25L=n
CONFIG_MTD_NAND_DENALI_DT=n
CONFIG_MTD_NAND_MARVELL=n
CONFIG_MTD_NAND_FSL_IFC=n
CONFIG_SCSI_HISI_SAS=n
CONFIG_SCSI_HISI_SAS_PCI=n
CONFIG_SCSI_UFS_HISI=n
CONFIG_SCSI_UFS_EXYNOS=n
CONFIG_AHCI_CEVA=n
CONFIG_AHCI_MVEBU=n
CONFIG_AHCI_XGENE=n
CONFIG_AHCI_QORIQ=n
CONFIG_SATA_SIL24=n
CONFIG_SATA_RCAR=n
CONFIG_FSL_FMAN=n
CONFIG_FSL_DPAA_ETH=n
CONFIG_FSL_DPAA2_ETH=n
CONFIG_FSL_ENETC=n
CONFIG_FSL_ENETC_VF=n
CONFIG_FSL_ENETC_QOS=n
CONFIG_HIX5HD2_GMAC=n
CONFIG_HNS_DSAF=n
CONFIG_HNS_ENET=n
CONFIG_HNS3=n
CONFIG_HNS3_HCLGE=n
CONFIG_HNS3_ENET=n
CONFIG_SERIAL_MESON=n
CONFIG_SERIAL_MESON_CONSOLE=n
CONFIG_SERIAL_SAMSUNG=n
CONFIG_SERIAL_SAMSUNG_CONSOLE=n
CONFIG_SERIAL_TEGRA=n
CONFIG_SERIAL_TEGRA_TCU=n
CONFIG_SERIAL_IMX=n
CONFIG_SERIAL_IMX_CONSOLE=n
CONFIG_SERIAL_XILINX_PS_UART=n
CONFIG_SERIAL_XILINX_PS_UART_CONSOLE=n
CONFIG_SERIAL_FSL_LPUART=n
CONFIG_SERIAL_FSL_LPUART_CONSOLE=n
CONFIG_SERIAL_FSL_LINFLEXUART=n
CONFIG_SERIAL_FSL_LINFLEXUART_CONSOLE=n
CONFIG_SERIAL_MVEBU_UART=n
CONFIG_SERIAL_OWL=n
CONFIG_I2C_BCM2835=n
CONFIG_I2C_DESIGNWARE_PLATFORM=n
CONFIG_I2C_IMX=n
CONFIG_I2C_IMX_LPI2C=n
CONFIG_I2C_MESON=n
CONFIG_I2C_MT65XX=n
CONFIG_I2C_MV64XXX=n
CONFIG_I2C_OMAP=n
CONFIG_I2C_OWL=n
CONFIG_I2C_PXA=n
CONFIG_I2C_RK3X=n
CONFIG_I2C_SH_MOBILE=n
CONFIG_I2C_TEGRA=n
CONFIG_I2C_UNIPHIER_F=n
CONFIG_I2C_RCAR=n
CONFIG_SPI_ARMADA_3700=n
CONFIG_SPI_BCM2835=n
CONFIG_SPI_BCM2835AUX=n
CONFIG_SPI_DESIGNWARE=n
CONFIG_SPI_DW_DMA=n
CONFIG_SPI_DW_MMIO=n
CONFIG_SPI_FSL_LPSPI=n
CONFIG_SPI_FSL_QUADSPI=n
CONFIG_SPI_IMX=n
CONFIG_SPI_FSL_DSPI=n
CONFIG_SPI_MESON_SPICC=n
CONFIG_SPI_MESON_SPIFC=n
CONFIG_SPI_ORION=n
CONFIG_SPI_PL022=n
CONFIG_SPI_ROCKCHIP=n
CONFIG_SPI_RPCIF=n
CONFIG_SPI_S3C64XX=n
CONFIG_SPI_SH_MSIOF=n
CONFIG_SPI_SUN6I=n
CONFIG_PINCTRL_MAX77620=n
CONFIG_PINCTRL_OWL=n
CONFIG_PINCTRL_S700=n
CONFIG_PINCTRL_S900=n
CONFIG_PINCTRL_IMX8MM=n
CONFIG_PINCTRL_IMX8MN=n
CONFIG_PINCTRL_IMX8MP=n
CONFIG_PINCTRL_IMX8MQ=n
CONFIG_PINCTRL_IMX8QM=n
CONFIG_PINCTRL_IMX8QXP=n
CONFIG_PINCTRL_IMX8DXL=n
CONFIG_GPIO_ALTERA=n
CONFIG_GPIO_DAVINCI=n
CONFIG_GPIO_MPC8XXX=n
CONFIG_GPIO_MXC=n
CONFIG_GPIO_PL061=n
CONFIG_GPIO_RCAR=n
CONFIG_GPIO_UNIPHIER=n
CONFIG_GPIO_VISCONTI=n
CONFIG_GPIO_XGENE=n
CONFIG_GPIO_XGENE_SB=n
CONFIG_GPIO_PCA953X_IRQ=n
CONFIG_GPIO_BD9571MWV=n
CONFIG_GPIO_MAX77620=n
CONFIG_GPIO_SL28CPLD=n
CONFIG_ROCKCHIP_IODOMAIN=n
CONFIG_POWER_RESET_XGENE=n
CONFIG_POWER_RESET_SYSCON_POWEROFF=n
CONFIG_GNSS_MTK_SERIAL=n
CONFIG_SENSORS_RASPBERRYPI_HWMON=n
CONFIG_SENSORS_SL28CPLD=n
CONFIG_QORIQ_THERMAL=n
CONFIG_SUN8I_THERMAL=n
CONFIG_IMX_SC_THERMAL=n
CONFIG_IMX8MM_THERMAL=n
CONFIG_ROCKCHIP_THERMAL=n
CONFIG_RCAR_THERMAL=n
CONFIG_RCAR_GEN3_THERMAL=n
CONFIG_ARMADA_THERMAL=n
CONFIG_BCM2711_THERMAL=n
CONFIG_BCM2835_THERMAL=n
CONFIG_BRCMSTB_THERMAL=n
CONFIG_EXYNOS_THERMAL=n
CONFIG_TEGRA_BPMP_THERMAL=n
CONFIG_TEGRA_SOCTHERM=n
CONFIG_UNIPHIER_THERMAL=n
CONFIG_SL28CPLD_WATCHDOG=n
CONFIG_ARM_SP805_WATCHDOG=n
CONFIG_S3C2410_WATCHDOG=n
CONFIG_SUNXI_WATCHDOG=n
CONFIG_IMX2_WDT=n
CONFIG_IMX_SC_WDT=n
CONFIG_MESON_GXBB_WATCHDOG=n
CONFIG_MESON_WATCHDOG=n
CONFIG_RENESAS_WDT=n
CONFIG_UNIPHIER_WATCHDOG=n
CONFIG_BCM2835_WDT=n
CONFIG_MFD_ALTERA_SYSMGR=n
CONFIG_MFD_AXP20X_I2C=n
CONFIG_MFD_AXP20X_RSB=n
CONFIG_MFD_EXYNOS_LPASS=n
CONFIG_MFD_HI6421_PMIC=n
CONFIG_MFD_HI655X_PMIC=n
CONFIG_MFD_MT6397=n
CONFIG_MFD_RK808=n
CONFIG_MFD_SL28CPLD=n
CONFIG_REGULATOR_AXP20X=n
CONFIG_REGULATOR_BD718XX=n
CONFIG_REGULATOR_BD9571MWV=n
CONFIG_REGULATOR_HI6421V530=n
CONFIG_REGULATOR_HI655X=n
CONFIG_REGULATOR_MAX77620=n
CONFIG_REGULATOR_MP8859=n
CONFIG_REGULATOR_MT6358=n
CONFIG_REGULATOR_MT6397=n
CONFIG_REGULATOR_PF8X00=n
CONFIG_REGULATOR_RK808=n
CONFIG_REGULATOR_S2MPS11=n
CONFIG_REGULATOR_TPS65132=n
CONFIG_IR_MESON=n
CONFIG_IR_SUNXI=n
CONFIG_MEDIA_ANALOG_TV_SUPPORT=n
CONFIG_MEDIA_DIGITAL_TV_SUPPORT=n
CONFIG_MEDIA_SDR_SUPPORT=n
CONFIG_VIDEO_RCAR_CSI2=n
CONFIG_VIDEO_RCAR_VIN=n
CONFIG_VIDEO_SUN6I_CSI=n
CONFIG_VIDEO_SAMSUNG_S5P_JPEG=n
CONFIG_VIDEO_SAMSUNG_S5P_MFC=n
CONFIG_VIDEO_SAMSUNG_EXYNOS_GSC=n
CONFIG_VIDEO_RENESAS_FDP1=n
CONFIG_VIDEO_RENESAS_FCP=n
CONFIG_VIDEO_RENESAS_VSP1=n
CONFIG_SDR_PLATFORM_DRIVERS=n
CONFIG_VIDEO_RCAR_DRIF=n
CONFIG_DRM_I2C_NXP_TDA998X=n
CONFIG_DRM_MALI_DISPLAY=n
CONFIG_DRM_NOUVEAU=n
CONFIG_DRM_EXYNOS=n
CONFIG_DRM_EXYNOS5433_DECON=n
CONFIG_DRM_EXYNOS7_DECON=n
CONFIG_DRM_EXYNOS_DSI=n
CONFIG_DRM_EXYNOS_HDMI=n
CONFIG_DRM_EXYNOS_MIC=n
CONFIG_DRM_ROCKCHIP=n
CONFIG_ROCKCHIP_ANALOGIX_DP=n
CONFIG_ROCKCHIP_CDN_DP=n
CONFIG_ROCKCHIP_DW_HDMI=n
CONFIG_ROCKCHIP_DW_MIPI_DSI=n
CONFIG_ROCKCHIP_INNO_HDMI=n
CONFIG_ROCKCHIP_LVDS=n
CONFIG_DRM_RCAR_DU=n
CONFIG_DRM_RCAR_DW_HDMI=n
CONFIG_DRM_SUN4I=n
CONFIG_DRM_SUN6I_DSI=n
CONFIG_DRM_SUN8I_DW_HDMI=n
CONFIG_DRM_SUN8I_MIXER=n
CONFIG_DRM_TEGRA=n
CONFIG_DRM_PARADE_PS8640=n
CONFIG_DRM_SII902X=n
CONFIG_DRM_THINE_THC63LVD1024=n
CONFIG_DRM_VC4=n
CONFIG_DRM_ETNAVIV=n
CONFIG_DRM_HISI_HIBMC=n
CONFIG_DRM_HISI_KIRIN=n
CONFIG_DRM_MEDIATEK=n
CONFIG_DRM_MEDIATEK_HDMI=n
CONFIG_DRM_MESON=n
CONFIG_DRM_PL111=n
CONFIG_DRM_LIMA=n
CONFIG_SND_HDA_TEGRA=n
CONFIG_SND_HDA_CODEC_HDMI=n
CONFIG_SND_BCM2835_SOC_I2S=n
CONFIG_SND_SOC_FSL_EASRC=n
CONFIG_SND_IMX_SOC=n
CONFIG_SND_SOC_IMX_SGTL5000=n
CONFIG_SND_SOC_IMX_SPDIF=n
CONFIG_SND_SOC_IMX_AUDMIX=n
CONFIG_SND_SOC_FSL_ASOC_CARD=n
CONFIG_SND_MESON_AXG_SOUND_CARD=n
CONFIG_SND_MESON_GX_SOUND_CARD=n
CONFIG_SND_SOC_ROCKCHIP=n
CONFIG_SND_SOC_ROCKCHIP_SPDIF=n
CONFIG_SND_SOC_ROCKCHIP_RT5645=n
CONFIG_SND_SOC_RK3399_GRU_SOUND=n
CONFIG_SND_SOC_SAMSUNG=n
CONFIG_SND_SOC_RCAR=n
CONFIG_SND_SUN4I_I2S=n
CONFIG_SND_SUN4I_SPDIF=n
CONFIG_SND_SOC_TEGRA=n
CONFIG_SND_SOC_TEGRA210_AHUB=n
CONFIG_SND_SOC_TEGRA210_DMIC=n
CONFIG_SND_SOC_TEGRA210_I2S=n
CONFIG_SND_SOC_TEGRA186_DSPK=n
CONFIG_SND_SOC_TEGRA210_ADMAIF=n
CONFIG_SND_SOC_TEGRA_AUDIO_GRAPH_CARD=n
CONFIG_SND_SOC_GTM601=n
CONFIG_SND_SOC_RT5659=n
CONFIG_SND_SOC_WM8960=n
CONFIG_SND_SOC_WM8962=n
CONFIG_USB_XHCI_PCI_RENESAS=n
CONFIG_USB_XHCI_TEGRA=n
CONFIG_USB_EHCI_EXYNOS=n
CONFIG_USB_OHCI_EXYNOS=n
CONFIG_USB_RENESAS_USBHS_HCD=n
CONFIG_USB_RENESAS_USBHS=n
CONFIG_USB_CHIPIDEA_UDC=n
CONFIG_USB_CHIPIDEA_HOST=n
CONFIG_USB_RENESAS_USBHS_UDC=n
CONFIG_USB_RENESAS_USB3=n
CONFIG_USB_TEGRA_XUDC=n
CONFIG_MMC_SDHCI_OF_ARASAN=n
CONFIG_MMC_SDHCI_OF_ESDHC=n
CONFIG_MMC_SDHCI_ESDHC_IMX=n
CONFIG_MMC_SDHCI_TEGRA=n
CONFIG_MMC_MESON_GX=n
CONFIG_MMC_DW_EXYNOS=n
CONFIG_MMC_DW_HI3798CV200=n
CONFIG_MMC_DW_K3=n
CONFIG_MMC_DW_ROCKCHIP=n
CONFIG_MMC_SUNXI=n
CONFIG_MMC_BCM2835=n
CONFIG_MMC_MTK=n
CONFIG_MMC_SDHCI_XENON=n
CONFIG_MMC_SDHCI_AM654=n
CONFIG_MMC_OWL=n
CONFIG_RTC_DRV_MAX77686=n
CONFIG_RTC_DRV_RK808=n
CONFIG_RTC_DRV_M41T80=n
CONFIG_RTC_DRV_RV3028=n
CONFIG_RTC_DRV_S5M=n
CONFIG_RTC_DRV_FSL_FTM_ALARM=n
CONFIG_RTC_DRV_S3C=n
CONFIG_RTC_DRV_PL031=n
CONFIG_RTC_DRV_SUN6I=n
CONFIG_RTC_DRV_ARMADA38X=n
CONFIG_RTC_DRV_TEGRA=n
CONFIG_RTC_DRV_SNVS=n
CONFIG_RTC_DRV_IMX_SC=n
CONFIG_RTC_DRV_XGENE=n
CONFIG_DMA_BCM2835=n
CONFIG_DMA_SUN6I=n
CONFIG_FSL_EDMA=n
CONFIG_IMX_SDMA=n
CONFIG_K3_DMA=n
CONFIG_MV_XOR=n
CONFIG_MV_XOR_V2=n
CONFIG_OWL_DMA=n
CONFIG_TEGRA20_APB_DMA=n
CONFIG_TEGRA210_ADMA=n
CONFIG_RCAR_DMAC=n
CONFIG_RENESAS_USB_DMAC=n
CONFIG_TI_K3_UDMA=n
CONFIG_TI_K3_UDMA_GLUE_LAYER=n
CONFIG_COMMON_CLK_RK808=n
CONFIG_COMMON_CLK_FSL_SAI=n
CONFIG_COMMON_CLK_S2MPS11=n
CONFIG_COMMON_CLK_ZYNQMP=n
CONFIG_COMMON_CLK_BD718XX=n
CONFIG_CLK_RASPBERRYPI=n
CONFIG_CLK_IMX8MM=n
CONFIG_CLK_IMX8MN=n
CONFIG_CLK_IMX8MP=n
CONFIG_CLK_IMX8MQ=n
CONFIG_CLK_IMX8QXP=n
CONFIG_TI_SCI_CLK=n
CONFIG_IMX_MBOX=n
CONFIG_BCM2835_MBOX=n
CONFIG_ROCKCHIP_IOMMU=n
CONFIG_TEGRA_IOMMU_SMMU=n
CONFIG_MTK_IOMMU=n
CONFIG_OWL_PM_DOMAINS=n
CONFIG_RASPBERRYPI_POWER=n
CONFIG_FSL_DPAA=n
CONFIG_FSL_MC_DPIO=n
CONFIG_FSL_RCPM=n
CONFIG_MTK_PMIC_WRAP=n
CONFIG_ARCH_R8A774A1=n
CONFIG_ARCH_R8A774B1=n
CONFIG_ARCH_R8A774C0=n
CONFIG_ARCH_R8A774E1=n
CONFIG_ARCH_R8A77950=n
CONFIG_ARCH_R8A77951=n
CONFIG_ARCH_R8A77960=n
CONFIG_ARCH_R8A77961=n
CONFIG_ARCH_R8A77965=n
CONFIG_ARCH_R8A77970=n
CONFIG_ARCH_R8A77980=n
CONFIG_ARCH_R8A77990=n
CONFIG_ARCH_R8A77995=n
CONFIG_ARCH_R8A779A0=n
CONFIG_ARCH_R9A07G044=n
CONFIG_ROCKCHIP_PM_DOMAINS=n
CONFIG_ARCH_TEGRA_132_SOC=n
CONFIG_ARCH_TEGRA_210_SOC=n
CONFIG_ARCH_TEGRA_186_SOC=n
CONFIG_ARCH_TEGRA_194_SOC=n
CONFIG_ARCH_TEGRA_234_SOC=n
CONFIG_TI_SCI_PM_DOMAINS=n
CONFIG_ARM_IMX_BUS_DEVFREQ=n
CONFIG_ARM_IMX8M_DDRC_DEVFREQ=n
CONFIG_RENESAS_RPCIF=n
CONFIG_EXYNOS_ADC=n
CONFIG_MAX9611=n
CONFIG_ROCKCHIP_SARADC=n
CONFIG_PWM_BCM2835=n
CONFIG_PWM_IMX27=n
CONFIG_PWM_MESON=n
CONFIG_PWM_MTK_DISP=n
CONFIG_PWM_MEDIATEK=n
CONFIG_PWM_RCAR=n
CONFIG_PWM_ROCKCHIP=n
CONFIG_PWM_SAMSUNG=n
CONFIG_PWM_SL28CPLD=n
CONFIG_PWM_SUN4I=n
CONFIG_PWM_TEGRA=n
CONFIG_PWM_VISCONTI=n
CONFIG_SL28CPLD_INTC=n
CONFIG_RESET_IMX7=n
CONFIG_RESET_TI_SCI=n
CONFIG_PHY_XGENE=n
CONFIG_PHY_SUN4I_USB=n
CONFIG_PHY_HI6220_USB=n
CONFIG_PHY_HISTB_COMBPHY=n
CONFIG_PHY_HISI_INNO_USB2=n
CONFIG_PHY_MVEBU_CP110_COMPHY=n
CONFIG_PHY_MTK_TPHY=n
CONFIG_PHY_RCAR_GEN3_PCIE=n
CONFIG_PHY_RCAR_GEN3_USB2=n
CONFIG_PHY_RCAR_GEN3_USB3=n
CONFIG_PHY_ROCKCHIP_EMMC=n
CONFIG_PHY_ROCKCHIP_INNO_HDMI=n
CONFIG_PHY_ROCKCHIP_INNO_USB2=n
CONFIG_PHY_ROCKCHIP_INNO_DSIDPHY=n
CONFIG_PHY_ROCKCHIP_PCIE=n
CONFIG_PHY_ROCKCHIP_TYPEC=n
CONFIG_PHY_SAMSUNG_UFS=n
CONFIG_PHY_UNIPHIER_USB2=n
CONFIG_PHY_UNIPHIER_USB3=n
CONFIG_PHY_TEGRA_XUSB=n
CONFIG_FSL_IMX8_DDR_PMU=n
CONFIG_HISI_PMU=n
CONFIG_NVMEM_IMX_OCOTP=n
CONFIG_NVMEM_IMX_OCOTP_SCU=n
CONFIG_MTK_EFUSE=n
CONFIG_ROCKCHIP_EFUSE=n
CONFIG_NVMEM_SUNXI_SID=n
CONFIG_UNIPHIER_EFUSE=n
CONFIG_MESON_EFUSE=n
CONFIG_NVMEM_RMEM=n
CONFIG_FPGA=n
CONFIG_FPGA_MGR_STRATIX10_SOC=n
CONFIG_FPGA_BRIDGE=n
CONFIG_ALTERA_FREEZE_BRIDGE=n
CONFIG_FPGA_REGION=n
CONFIG_OF_FPGA_REGION=n
CONFIG_INTERCONNECT_IMX=n
CONFIG_INTERCONNECT_IMX8MQ=n
CONFIG_INTERCONNECT_QCOM_MSM8996=n
CONFIG_INTERCONNECT_QCOM_QCS404=n
CONFIG_INTERCONNECT_QCOM_SC7180=n
CONFIG_INTERCONNECT_QCOM_SM8150=n
CONFIG_INTERCONNECT_QCOM_SM8350=n
CONFIG_INTERCONNECT_QCOM_SM8450=n
CONFIG_INTERCONNECT_QCOM_SC8280XP=n
CONFIG_ARCH_BCMBCA=n
CONFIG_ARCH_NPCM=n
CONFIG_SERIAL_BCM63XX=n
CONFIG_PINCTRL_SC8280XP=n
CONFIG_SC_GCC_8280XP=n
CONFIG_BCM_SBA_RAID=n
CONFIG_DMA_ENGINE_RAID=n
CONFIG_SENSORS_GPIO_FAN=n
CONFIG_ARCH_BCM=n
CONFIG_ARCH_NXP=n
CONFIG_NET_VENDOR_ADI=n
CONFIG_PINCTRL_SC8180X=n
CONFIG_SND_SOC_SC7180=n
CONFIG_SND_SOC_SC7280=n
CONFIG_SND_SOC_ADAU7002=n
CONFIG_SND_SOC_RT5682=n
CONFIG_SND_SOC_RT5682_I2C=n
CONFIG_SND_SOC_RT5682S=n
CONFIG_MMC_SDHCI_OF_DWCMSHC=n
CONFIG_CROS_TYPEC_SWITCH=n
CONFIG_SC_GCC_8180X=n
CONFIG_IOMMU_IO_PGTABLE_DART=n
CONFIG_INTERCONNECT_QCOM_SC8180X=n
CONFIG_MEMORY_HOTPLUG=n
CONFIG_MELLANOX_PLATFORM=n
CONFIG_CHROME_PLATFORMS=n
CONFIG_PINCTRL_SM8150=n
CONFIG_SM_GCC_8150=n
CONFIG_SM_GPUCC_8150=n
CONFIG_PINCTRL_SM8350=n
CONFIG_SM_GCC_8350=n
CONFIG_SM_DISPCC_8450=n
CONFIG_SM_GCC_8450=n
CONFIG_ARCH_SPARX5=n
CONFIG_ARCH_MA35=n
CONFIG_ARCH_REALTEK=n
CONFIG_ARCH_STM32=n
CONFIG_DRM_TIDSS=n
CONFIG_DRM_POWERVR=n
CONFIG_ARCH_AIROHA=n
CONFIG_DRM_PANTHOR=n
```
