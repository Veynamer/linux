## Documentation/devicetree/bindings/clock/sprd,ums512-clk.yaml
```yaml
# SPDX-License-Identifier: (GPL-2.0-only OR BSD-2-Clause)
# Copyright 2022 Unisoc Inc.
%YAML 1.2
---
$id: http://devicetree.org/schemas/clock/sprd,ums512-clk.yaml#
$schema: http://devicetree.org/meta-schemas/core.yaml#

title: UMS512 Soc clock controller

maintainers:
  - Orson Zhai <orsonzhai@gmail.com>
  - Baolin Wang <baolin.wang7@gmail.com>
  - Chunyan Zhang <zhang.lyra@gmail.com>

properties:
  compatible:
    enum:
      - sprd,ums512-apahb-gate
      - sprd,ums512-ap-clk
      - sprd,ums512-aonapb-clk
      - sprd,ums512-pmu-gate
      - sprd,ums512-g0-pll
      - sprd,ums512-g2-pll
      - sprd,ums512-g3-pll
      - sprd,ums512-gc-pll
      - sprd,ums512-aon-gate
      - sprd,ums512-audcpapb-gate
      - sprd,ums512-audcpahb-gate
      - sprd,ums512-gpu-clk
      - sprd,ums512-mm-clk
      - sprd,ums512-mm-gate-clk
      - sprd,ums512-apapb-gate

  "#clock-cells":
    const: 1

  power-domains:
    maxItems: 1

  reg:
    maxItems: 1

  "#reset-cells":
    const: 1

allOf:
  - if:
      properties:
        compatible:
          contains:
            const: sprd,ums512-aonapb-clk
    then:
      properties:
        clocks:
          minItems: 4
          maxItems: 4
        clock-names:
          items:
            - const: ext-26m
            - const: ext-32k
            - const: ext-4m
            - const: rco-100m
      required:
        - clocks
        - clock-names

  - if:
      properties:
        compatible:
          contains:
            const: sprd,ums512-mm-clk
    then:
      properties:
        clocks:
          minItems: 2
          maxItems: 2
        clock-names:
          items:
            - const: ext-26m
            - const: enable
      required:
        - clocks
        - clock-names

  - if:
      properties:
        compatible:
          contains:
            enum:
              - sprd,ums512-apahb-gate
              - sprd,ums512-ap-clk
              - sprd,ums512-aon-gate
              - sprd,ums512-pmu-gate
              - sprd,ums512-g3-pll
              - sprd,ums512-gc-pll
              - sprd,ums512-gpu-clk
    then:
      properties:
        clocks:
          minItems: 1
          maxItems: 1
        clock-names:
          items:
            - const: ext-26m
      required:
        - clocks
        - clock-names

required:
  - compatible
  - '#clock-cells'
  - reg

unevaluatedProperties: false

examples:
  - |
    ap_clk: clock-controller@20200000 {
      compatible = "sprd,ums512-ap-clk";
      reg = <0x20200000 0x1000>;
      clocks = <&ext_26m>;
      clock-names = "ext-26m";
      #clock-cells = <1>;
    };
...
```

## Documentation/devicetree/bindings/input/touchscreen/omnivision,tcm-spi.yaml
```yaml
# SPDX-License-Identifier: (GPL-2.0-only OR BSD-2-Clause)
%YAML 1.2
---
$id: http://devicetree.org/schemas/input/touchscreen/omnivision,tcm-spi.yaml#
$schema: http://devicetree.org/meta-schemas/core.yaml#

title: Omnivision TouchComm touchscreen controller (SPI)

maintainers:
  - Veynamer <veyr1thalone@gmail.com>

allOf:
  - $ref: touchscreen.yaml#
  - $ref: /schemas/spi/spi-peripheral-props.yaml#

properties:
  compatible:
    const: omnivision,tcm-spi

  reg:
    maxItems: 1

  interrupts:
    maxItems: 1

  firmware-name:
    description:
      Name of the firmware image loaded into the controller when it is in
      HDL/ROMBOOT mode.

  omnivision,irq-gpio:
    description: GPIO connected to the controller interrupt line.
    maxItems: 1

  omnivision,reset-gpio:
    description: GPIO connected to the controller reset line.
    maxItems: 1

  omnivision,power-gpio:
    description: GPIO controlling the controller power.
    maxItems: 1

  omnivision,tpio-reset-gpio:
    description: GPIO connected to the test-point reset line.
    maxItems: 1

  omnivision,irq-on-state:
    description: Value driven on the IRQ GPIO when the interrupt is active.
    $ref: /schemas/types.yaml#/definitions/uint32
    enum: [0, 1]

  omnivision,reset-on-state:
    description: Value driven on the reset GPIO to assert reset.
    $ref: /schemas/types.yaml#/definitions/uint32
    enum: [0, 1]

  omnivision,power-on-state:
    description: Value driven on the power GPIO to power the controller on.
    $ref: /schemas/types.yaml#/definitions/uint32
    enum: [0, 1]

  omnivision,power-delay-ms:
    description: Delay in milliseconds after enabling power.
    $ref: /schemas/types.yaml#/definitions/uint32

  omnivision,reset-active-ms:
    description: Duration in milliseconds the reset line is held asserted.
    $ref: /schemas/types.yaml#/definitions/uint32

  omnivision,reset-delay-ms:
    description: Delay in milliseconds after releasing reset.
    $ref: /schemas/types.yaml#/definitions/uint32

  omnivision,pwr-reg-name:
    description: Name of the analog power supply regulator.
    $ref: /schemas/types.yaml#/definitions/string

  omnivision,bus-reg-name:
    description: Name of the bus I/O power supply regulator.
    $ref: /schemas/types.yaml#/definitions/string

  omnivision,spi-mode:
    description: SPI mode (0-3) used for SPI transfers.
    $ref: /schemas/types.yaml#/definitions/uint32

  omnivision,byte-delay-us:
    description: Delay in microseconds between bytes during SPI transfers.
    $ref: /schemas/types.yaml#/definitions/uint32

  omnivision,block-delay-us:
    description: Delay in microseconds between blocks during SPI transfers.
    $ref: /schemas/types.yaml#/definitions/uint32

  omnivision,ubl-max-freq:
    description: Maximum SPI clock frequency in Hz for the bootloader mode.
    $ref: /schemas/types.yaml#/definitions/uint32

  omnivision,ubl-byte-delay-us:
    description: Delay in microseconds between bytes for the bootloader mode.
    $ref: /schemas/types.yaml#/definitions/uint32

  omnivision,x-flip:
    description: Invert the X axis.
    type: boolean

  omnivision,y-flip:
    description: Invert the Y axis.
    type: boolean

  omnivision,swap-axes:
    description: Swap the X and Y axes.
    type: boolean

required:
  - compatible
  - reg

unevaluatedProperties: false

examples:
  - |
    #include <dt-bindings/gpio/gpio.h>

    spi {
        #address-cells = <1>;
        #size-cells = <0>;

        touchscreen@0 {
            compatible = "omnivision,tcm-spi";
            reg = <0>;

            spi-max-frequency = <9600000>;

            firmware-name = "X6816DRU_TD4160_TM_fw.img";

            omnivision,irq-gpio = <&gpio 144 GPIO_ACTIVE_HIGH>;
            omnivision,reset-gpio = <&gpio 145 GPIO_ACTIVE_HIGH>;
            omnivision,irq-on-state = <0>;
            omnivision,reset-on-state = <0>;
            omnivision,reset-active-ms = <20>;
            omnivision,reset-delay-ms = <200>;
            omnivision,spi-mode = <3>;
            omnivision,byte-delay-us = <0>;
            omnivision,block-delay-us = <0>;
        };
    };
```

## Documentation/devicetree/bindings/input/touchscreen/omnivision_tcm-spi.yaml
```yaml
# SPDX-License-Identifier: GPL-2.0
%YAML 1.2
---
$id: http://devicetree.org/schemas/input/touchscreen/omnivision_tcm-spi.yaml#
$schema: http://devicetree.org/meta-schemas/core.yaml#

title: Omnivision TouchComm touchscreen controller (SPI)

maintainers:
  - Veynamer <veyr1thalone@gmail.com>

allOf:
  - $ref: touchscreen.yaml#
  - $ref: /schemas/spi/spi-peripheral-props.yaml#

properties:
  compatible:
    const: omnivision_tcm-spi

  reg:
    maxItems: 1

  interrupts:
    maxItems: 1

  reset-gpios:
    maxItems: 1

  vdd-supply:
    description: analog power supply.

required:
  - compatible
  - reg
  - interrupts

additionalProperties: false
```

## Documentation/devicetree/bindings/power/supply/sc27xx-bc1p2.yaml
```yaml
# SPDX-License-Identifier: GPL-2.0
%YAML 1.2
---
$id: http://devicetree.org/schemas/power/supply/sc27xx-bc1p2.yaml#
$schema: http://devicetree.org/meta-schemas/core.yaml#

title: Spreadtrum SC27XX PMICs BC1.2 charger detection

maintainers:
  - Veynamer <veyr1thalone@gmail.com>

allOf:
  - $ref: power-supply.yaml#

properties:
  compatible:
    enum:
      - sprd,sc2720-bc1p2
      - sprd,sc2721-bc1p2
      - sprd,sc2730-bc1p2
      - sprd,sc2731-bc1p2

  reg:
    maxItems: 1

required:
  - compatible
  - reg

additionalProperties: false

examples:
  - |
    pmic {
        #address-cells = <1>;
        #size-cells = <0>;

        charger-detect@1b9c {
            compatible = "sprd,sc2730-bc1p2";
            reg = <0x1b9c>;
        };
    };
...
```
