## drivers/misc/unisoc/Kconfig
```kconfig
# SPDX-License-Identifier: GPL-2.0-only

source "drivers/misc/unisoc/wcn/Kconfig"
```

## drivers/misc/unisoc/wcn/Kconfig
```kconfig
# SPDX-License-Identifier: GPL-2.0-only

config UNISOC_WCN_SDIO
	tristate "Unisoc Marlin3 WCN over SDIO"
	depends on MMC && OF
	depends on FW_LOADER
	help
	  Shared driver for Unisoc Marlin3 wireless combo chips attached over
	  SDIO. It provides firmware download, packet channels, power
	  management and reset for the Wi-Fi, Bluetooth, FM and GNSS devices.
	  Currently the Marlin3lite (UMW2652) variant is supported.

	  To compile this driver as a module, choose M here: the module
	  will be called unisoc-wcn-sdio.
```

## drivers/misc/unisoc/wcn_sdio/Kconfig
```kconfig
# SPDX-License-Identifier: GPL-2.0-only

config UNISOC_WCN_SDIO
	tristate "Unisoc SC2355 WCN SDIO core"
	depends on MMC && OF
	depends on FW_LOADER
	help
	  Core driver for the external Unisoc SC2355 (Marlin3-Lite)
	  WCN combo attached over SDIO. It provides firmware download,
	  SDIO packet channel transport, runtime reset and platform
	  devices for the Wi-Fi, Bluetooth, FM and GNSS functions.

	  To compile this driver as a module, choose M here: the module
	  will be called unisoc-wcn-sdio.
```

## drivers/soc/sprd/Kconfig
```kconfig
# SPDX-License-Identifier: GPL-2.0-only

menu "Spreadtrum and Unisoc SoC drivers"

config SPRD_AGDSP
	tristate "Audio DSP support"
	depends on ARCH_SPRD || COMPILE_TEST
	depends on MAILBOX
	help
	  Say y here to enable support for communication with the audio
	  DSP found in Spreadtrum/Unisoc SoCs.

config SPRD_CPU_DVFS
	bool
	select PM_OPP
	select NVMEM
	select MFD_SYSCON

config SPRD_UMS512_CPU_DVFS
	bool

config SPRD_UMS512_GPU_DVFS
	bool "UMS512 GPU hardware DVFS support"
	depends on SPRD_UMS512_CLK=y && PM
	select MFD_SYSCON
	default y
	help
	  Request GPU clock rates through the UMS512 hardware DVFS engine,
	  which coordinates GPU clocks and the shared MM/modem voltage.
	  This provides the core, memory and system clocks used by Panfrost
	  and retains the shared voltage banks initialized by firmware.

endmenu
```

## sound/soc/sprd/Kconfig
```kconfig
# SPDX-License-Identifier: GPL-2.0-only
menuconfig SND_SOC_SPRD
	tristate "Spreadtrum"
	depends on ARCH_SPRD || COMPILE_TEST
	help
	  Say Y or M if you want to add support for codecs attached to
	  the Spreadtrum SoCs' Audio interfaces.

if SND_SOC_SPRD

config SND_SOC_SPRD_COMMON
	tristate

config SND_SOC_SPRD_PLATFORM
	tristate
	select SND_SOC_COMPRESS

config SND_SOC_SPRD_MCDT
	tristate "Spreadtrum multi-channel data transfer support"
	depends on SND_SOC_SPRD
	help
	  Say y here to enable multi-channel data transfer support. It
	  is used for sound stream transmission between audio subsystem
	  and other AP/CP subsystem.

config SND_SOC_SPRD_UMS512
	tristate "SoC Audio support for UMS512"
	depends on SND_SOC_SPRD
	depends on SPRD_AGDSP
	select SND_SOC_SPRD_COMMON
	select SND_SOC_SPRD_MCDT
	select SND_SOC_SPRD_PLATFORM
	select SND_SOC_SPRD_VBC_V4_DSP
	help
	  Enable the ASoC machine driver for Unisoc UMS512 systems. It
	  connects the VBC DSP frontends to the digital and analog codecs,
	  with board-specific routing and backend links supplied by DT.

	  To compile this driver as a module, choose M here: the module
	  will be called snd-soc-ums512.

config SND_SOC_SPRD_UMS9230
	tristate "SoC Audio support for UMS9230"
	depends on SND_SOC_SPRD
	depends on SPRD_AGDSP
	select SND_SOC_SPRD_COMMON
	select SND_SOC_SPRD_MCDT
	select SND_SOC_SPRD_PLATFORM
	select SND_SOC_SPRD_VBC_V4_DSP
	help
	  Say Y here to enable audio support for typical systems such as
	  mobile phones based on the Unisoc UMS9230 SoC.

config SND_SOC_SPRD_VBC_V4_DSP
	tristate "Unisoc VBC v4 (DSP) support"
	depends on SPRD_AGDSP
	depends on SND_SOC_SPRD_MCDT
	help
	  Say Y here to add support for DSP-based audio in SoCs such as
	  UMS512 and UMS9230.

endif
```
